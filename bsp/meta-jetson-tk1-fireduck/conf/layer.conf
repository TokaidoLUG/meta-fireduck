## bsp/meta-jetson-tk1-fireduck/conf/layer.conf
```bitbake
# We have a conf and classes directory, add to BBPATH
BBPATH =. "${LAYERDIR}:"

# We have recipes-* directories, add to BBFILES
BBFILES += "${LAYERDIR}/recipes-*/*/*.bb \
            ${LAYERDIR}/recipes-*/*/*.bbappend"

BBFILE_COLLECTIONS += "jetson-tk1-fireduck"
BBFILE_PATTERN_jetson-tk1-fireduck = "^${LAYERDIR}/"
BBFILE_PRIORITY_jetson-tk1-fireduckt = "60"
```

## conf/distro/fireduck.conf
```bitbake
require conf/distro/poky.conf

# Fireduck OS specific derivations
DISTRO = "fireduck"
DISTRO_NAME = "Fireduck OS"
DISTRO_VERSION = "0.0.1"
DISTRO_CODENAME = "ahiruyaki"
SDK_VENDOR = "-sdk"
SDK_VERSION := "${@'${DISTRO_VERSION}'.replace('snapshot-${DATE}','snapshot')}"

MAINTAINER = "watatuki<wata2ki@gmail.com>"

TARGET_VENDOR = "-fireduck"

# Override these in poky based distros
AGL_DEFAULT_DISTRO_FEATURES = "largefile systemd opengl wayland pam bluetooth bluez5"
POKY_DEFAULT_DISTRO_FEATURES := "${AGL_DEFAULT_DISTRO_FEATURES}"
OVERRIDES .= ":${DISTRO_CODENAME}"

# Mirrors is not set
#PREMIRRORS ??= "\
#               "
#MIRRORS =+ "\
#           "

PREFERRED_PROVIDER_udev ?= "systemd"
PREFERRED_PROVIDER_udev-utils ?= "systemd"

VIRTUAL-RUNTIME_init_manager = "systemd"
VIRTUAL-RUNTIME_initscripts = ""

# network manager to use (possible values: systemd, connman)
VIRTUAL-RUNTIME_net_manager = "systemd" 

DISTRO_FEATURES_APPEND = " "
DISTRO_FEATURES_remove = " "
DISTRO_FEATURES_BACKFILL_CONSIDERED = "sysvinit"

# THE FUTURE is 'wic'
# IMAGE_FSTYPES_append = " wic"
```

## conf/layer.conf
```bitbake
# We have a conf and classes directory, add to BBPATH
BBPATH =. "${LAYERDIR}:"

# We have recipes-* directories, add to BBFILES
BBFILES += "${LAYERDIR}/recipes-*/*/*.bb \
            ${LAYERDIR}/recipes-*/*/*.bbappend"

BBFILE_COLLECTIONS += "fireduck"
BBFILE_PATTERN_fireduck = "^${LAYERDIR}/"
BBFILE_PRIORITY_fireduck = "25"
```

## feature/meta-browser-support/conf/layer.conf
```bitbake
# We have a conf and classes directory, add to BBPATH
BBPATH =. "${LAYERDIR}:"

# We have recipes-* directories, add to BBFILES
BBFILES += "${LAYERDIR}/recipes-*/*/*.bb \
            ${LAYERDIR}/recipes-*/*/*.bbappend"

BBFILE_COLLECTIONS += "browser-support"
BBFILE_PATTERN_browser-support = "^${LAYERDIR}/"
BBFILE_PRIORITY_browser-support = "26"
```

## feature/meta-enlightenment-support/conf/layer.conf
```bitbake
# We have a conf and classes directory, add to BBPATH
BBPATH =. "${LAYERDIR}:"

# We have recipes-* directories, add to BBFILES
BBFILES += "${LAYERDIR}/recipes-*/*/*.bb \
            ${LAYERDIR}/recipes-*/*/*.bbappend"

BBFILE_COLLECTIONS += "enlightenment-support"
BBFILE_PATTERN_enlightenment-support = "^${LAYERDIR}/"
BBFILE_PRIORITY_enlightenment-support = "26"
```

## feature/meta-fireduckwm-support/conf/layer.conf
```bitbake
# We have a conf and classes directory, add to BBPATH
BBPATH =. "${LAYERDIR}:"

# We have recipes-* directories, add to BBFILES
BBFILES += "${LAYERDIR}/recipes-*/*/*.bb \
            ${LAYERDIR}/recipes-*/*/*.bbappend"

BBFILE_COLLECTIONS += "fireduckwm-support"
BBFILE_PATTERN_fireduckwm-support = "^${LAYERDIR}/"
BBFILE_PRIORITY_fireduckwm-support = "26"
```

## feature/meta-lxqt-support/conf/layer.conf
```bitbake
# We have a conf and classes directory, add to BBPATH
BBPATH =. "${LAYERDIR}:"

# We have recipes-* directories, add to BBFILES
BBFILES += "${LAYERDIR}/recipes-*/*/*.bb \
            ${LAYERDIR}/recipes-*/*/*.bbappend"

BBFILE_COLLECTIONS += "lxqt-support"
BBFILE_PATTERN_lxqt-support = "^${LAYERDIR}/"
BBFILE_PRIORITY_lxqt-support = "26"
```
